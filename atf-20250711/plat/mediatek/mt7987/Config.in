## atf-20250711/plat/mediatek/mt7987/Config.in
```kconfig
# SPDX-License-Identifier: BSD-3-Clause
#
# Copyright (c) 2025 Daniel Golle <daniel@makrotopia.org>
# Copyright (c) 2026 Yuzhii0718 <admin@yuzhii0718.eu.org>
#
# MT7987 platform-specific configurations
#

if _PLAT_MT7987

config _ENABLE_I2P5G_PHY
	bool "Enable internal 2.5G PHY support"
	default y
	select _SUPPORTS_I2P5G_PHY

choice
	prompt "SPI controller"
	depends on (_BOOT_DEVICE_SPIM_NAND || _BOOT_DEVICE_SPI_NOR)
	default _SPIM_CTRL_0 if _BOOT_DEVICE_SPIM_NAND
	default _SPIM_CTRL_2 if _BOOT_DEVICE_SPI_NOR

	config _SPIM_CTRL_0
		bool "0"

	config _SPIM_CTRL_2
		bool "2"

endchoice

config SPIM_CTRL
	int
	default 0 if _SPIM_CTRL_0
	default 2 if _SPIM_CTRL_2

endif # _PLAT_MT7987
```
